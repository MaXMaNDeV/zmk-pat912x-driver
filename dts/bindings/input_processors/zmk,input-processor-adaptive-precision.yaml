## dts/bindings/input_processors/zmk,input-processor-adaptive-precision.yaml
```yaml
# Copyright (c) 2024 The ZMK Contributors
# SPDX-License-Identifier: MIT

description: |
  Input processor for adaptive precision (auto-snipe).
  Automatically reduces cursor speed when trackball movement slows down,
  enabling precision mode without holding a modifier key.

compatible: "zmk,input-processor-adaptive-precision"

include: ip_zero_param.yaml

properties:
  speed-threshold-low:
    type: int
    required: true
    description: |
      Speed-squared threshold to enter precision mode.
      Computed as dx*dx + dy*dy per sensor report pair.
      Lower value = harder to trigger. Start with 20.
  speed-threshold-high:
    type: int
    required: true
    description: |
      Speed-squared threshold to exit precision mode (hysteresis).
      Must be greater than speed-threshold-low. Start with 80.
  precision-numerator:
    type: int
    default: 1
    description: |
      Numerator for precision scaling fraction.
      Combined with precision-denominator: speed = numerator/denominator.
      e.g. numerator=2, denominator=5 → 2/5 speed.
  precision-denominator:
    type: int
    required: true
    description: |
      Denominator for precision scaling fraction.
      e.g. denominator=2 with default numerator=1 → 1/2 speed.
  min-dwell-ms:
    type: int
    default: 50
    description: |
      Minimum time (ms) to stay in each mode before switching.
      Prevents rapid oscillation between modes.
```

## src/pointing/Kconfig
```kconfig
config ZMK_INPUT_PROCESSOR_ADAPTIVE_PRECISION
	bool "Adaptive precision input processor (auto-snipe)"
	default y
	depends on DT_HAS_ZMK_INPUT_PROCESSOR_ADAPTIVE_PRECISION_ENABLED
	help
	  Automatically reduces cursor speed when trackball movement
	  slows down, enabling precision mode without a modifier key.
```
